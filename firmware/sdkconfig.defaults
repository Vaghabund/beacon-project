## firmware/sdkconfig.defaults
```kconfig
# ──────────────────────────────────────────────────────────────────────────────
# Beacon Project – sdkconfig.defaults
# Applied automatically by `idf.py build` if no sdkconfig exists yet.
# ──────────────────────────────────────────────────────────────────────────────

# CPU / Flash
CONFIG_IDF_TARGET="esp32s3"
CONFIG_ESP32S3_DEFAULT_CPU_FREQ_240=y
CONFIG_ESPTOOLPY_FLASHSIZE_8MB=y
CONFIG_ESPTOOLPY_FLASHMODE_QIO=y

# Custom partition table (see partitions.csv)
CONFIG_PARTITION_TABLE_CUSTOM=y
CONFIG_PARTITION_TABLE_CUSTOM_FILENAME="partitions.csv"

# PSRAM (Octal, 80 MHz) – required for 360×360 frame buffers
CONFIG_ESP32S3_SPIRAM_SUPPORT=y
CONFIG_SPIRAM=y
CONFIG_SPIRAM_MODE_OCT=y
CONFIG_SPIRAM_SPEED_80M=y
CONFIG_SPIRAM_USE_MALLOC=y
CONFIG_SPIRAM_MALLOC_ALWAYSINTERNAL=4096

# FreeRTOS tick rate
CONFIG_FREERTOS_HZ=1000

# WiFi
CONFIG_ESP_WIFI_STATIC_RX_BUFFER_NUM=16
CONFIG_ESP_WIFI_DYNAMIC_RX_BUFFER_NUM=32
CONFIG_ESP_WIFI_IRAM_OPT=y
CONFIG_ESP_WIFI_RX_IRAM_OPT=y

# Camera – OV2640
CONFIG_CAMERA_MODULE_OV2640=y

# Logging
CONFIG_LOG_DEFAULT_LEVEL_INFO=y

# mbedTLS – needed for MD5 SSID hashing in image_gen
CONFIG_MBEDTLS_MD5_C=y

# SPI flash / FATFS for SD card
CONFIG_FATFS_LFN_HEAP=y
CONFIG_FATFS_MAX_LFN=255
```
